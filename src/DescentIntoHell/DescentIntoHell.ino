#define MAX_SHOOT 30
#define MAX_MONSTER 5

//imports the SPI library (needed to communicate with Gamebuino's screen)
#include <SPI.h>
//importe the Gamebuino library
#include <Gamebuino.h>
//creates a Gamebuino object named gb
#include <EEPROM.h>

Gamebuino gb;

const byte logo[] PROGMEM = {64,30,0x0,0x0,0x0,0x0,0x0,0x0,0x0,0x0,0x0,0x0,0x0,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0x0,};

////////////Sprite model

const byte terrain[] PROGMEM = {88,48,0x80,0x0,0x0,0x0,0x0,0x0,0x0,0x0,0x0,0x0,0x10,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0x10,};

const byte perso_haut[] PROGMEM = {8,6,0x20,0x70,0x70,0x88,0x70,0xD8,};
const byte perso_droite[] PROGMEM = {8,6,0x20,0x50,0x70,0x48,0x70,0xD8,};
const byte perso_bas[] PROGMEM = {8,6,0x20,0x50,0x70,0x88,0x70,0xD8,};
const byte perso_gauche[] PROGMEM = {8,6,0x20,0x50,0x70,0x90,0x70,0xD8,};


#define NUM_SPRITES 4
const byte* Sprites_player[NUM_SPRITES] = {
  perso_haut, perso_droite, perso_bas, perso_gauche};

const byte porte_haut[] PROGMEM = {16,6,0x3F,0x0,0x7F,0x80,0x61,0x80,0xC0,0xC0,0xC0,0xC0,0x3F,0x0,};
const byte porte_droite[] PROGMEM = {8,10,0x60,0x78,0x9C,0x8C,0x8C,0x8C,0x8C,0x9C,0x78,0x60,};
const byte porte_bas[] PROGMEM = {16,6,0x3F,0x0,0xC0,0xC0,0xC0,0xC0,0x61,0x80,0x7F,0x80,0x3F,0x0,};
const byte porte_gauche[] PROGMEM = {8,10,0x18,0x78,0xE4,0xC4,0xC4,0xC4,0xC4,0xE4,0x78,0x18,};


const byte barriere_horizontal[] PROGMEM = {8,3,0xFC,0x48,0xFC,};
const byte barriere_vertical[] PROGMEM = {8,6,0xA0,0xE0,0xA0,0xA0,0xE0,0xA0,};

const byte descente_haut[] PROGMEM = {16,7,0x3F,0xC0,0x7F,0xE0,0x66,0x60,0x6F,0x60,0xCF,0x30,0xCF,0x30,0x10,0x80,};
const byte descente_droite[] PROGMEM = {8,12,0x60,0x7C,0x1C,0x86,0x76,0x7E,0x7E,0x76,0x86,0x1C,0x7C,0x60,};
const byte descente_bas[] PROGMEM = {16,7,0x10,0x80,0xCF,0x30,0xCF,0x30,0x6F,0x60,0x66,0x60,0x7F,0xE0,0x3F,0xC0,};
const byte descente_gauche[] PROGMEM = {8,12,0xC,0x7C,0x70,0xC2,0xDC,0xFC,0xFC,0xDC,0xC2,0x70,0x7C,0xC,};

const byte map_exit[] PROGMEM = {8,7,0x0,0x38,0x20,0x30,0x20,0x38,0x0,};
const byte map_perso[] PROGMEM = {8,7,0x0,0x10,0x0,0x38,0x10,0x28,0x0,};

const byte monstre1[] PROGMEM = {8,6,0x70,0xA8,0xF8,0x70,0xD8,0x88,};
const byte monstre2[] PROGMEM = {8,5,0x30,0xD0,0xA8,0x58,0x60,};
const byte monstre3[] PROGMEM = {8,5,0xCC,0x30,0x78,0x30,0x48,};
const byte monstre4[] PROGMEM = {8,7,0x20,0x70,0x50,0x88,0xF8,0xA8,0x50,};
const byte monstre5[] PROGMEM = {8,8,0x66,0x99,0x5A,0x0,0x3C,0x5A,0x18,0x24,};

#define NUM_MONSTER 5
const byte* Sprites_monster[NUM_MONSTER] = {
  monstre1,monstre2,monstre3,monstre4,monstre5};

///Item
const byte rate[] PROGMEM = {8,2,0x78,0xA0,};
const byte damage[] PROGMEM = {8,4,0x40,0xA0,0xE0,0xE0,};
const byte heal[] PROGMEM = {8,4,0xD8,0xF8,0x70,0x20,};

const byte* Sprites_item[3] = {
  rate,damage,heal};
  
////////////structure for player

typedef struct {
  int x;
  int y;
  int vx;
  int vy;
  int donjonroom;
  int orientation;
  int heal;
  int damage;
  int rate;
  int score;
  int invul;
} Config;
Config player;
boolean playintro=true;



//////////Variable for Donjon

//[Num_room,x, y, porte haut, porte droite, porte bas, porte gauche,visited]
int Donjon[8][25] = {{0,1,2,3,4,5,6,7,8,9,10,11,12,13,14,15,16,17,18,19,20,21,22,23,24},{0,1,2,3,4,0,1,2,3,4,0,1,2,3,4,0,1,2,3,4,0,1,2,3,4},{0,0,0,0,0,1,1,1,1,1,2,2,2,2,2,3,3,3,3,3,4,4,4,4,4},{0,0,0,0,0,0,0,0,0,0,0,0,0,0,0,0,0,0,0,0,0,0,0,0,0},{0,0,0,0,0,0,0,0,0,0,0,0,0,0,0,0,0,0,0,0,0,0,0,0,0},{0,0,0,0,0,0,0,0,0,0,0,0,0,0,0,0,0,0,0,0,0,0,0,0,0},{0,0,0,0,0,0,0,0,0,0,0,0,0,0,0,0,0,0,0,0,0,0,0,0,0},{0,0,0,0,0,0,0,0,0,0,0,0,1,0,0,0,0,0,0,0,0,0,0,0,0}};

int alea;
int cote;
int rando;
int ok=0;
int donjonlevel;
boolean finish=false;
boolean fin=false;


//////////Variable Shoot

const byte bullet[] PROGMEM = {8,2,0xC0,0xC0,};


float shootdelay;

typedef struct{
  boolean on;
  int x;
  int y;
  int vx;
  int vy;
  int orientation;
} 
confshoot;
confshoot shoot[MAX_SHOOT];


//////////Variable Monster

typedef struct{
  boolean on;
  int type;
  float x;
  float y;
  int vx;
  int vy;
  int heal;
  int damage;
  int time_step;
  int orientation;
} 
confmonster;
confmonster monster[8];
int wait=0;


//[number_monster,caracteristic_init][heal,damage,wait_time_under_step,]
int monstertype[NUM_MONSTER][3] = {{2,1,3},{1,1,1,},{2,2,2},{3,2,5},{5,2,1}};

//////////Variable Record

#define RANKMAX 5
int highscore[RANKMAX];
#define NAMELENGTH 10
char name[RANKMAX][NAMELENGTH+1];
extern const byte font3x5[];
extern const byte font5x7[];

//////////Structure item
typedef struct{
  boolean on;
  int type;
  int x;
  int y;
} 
confitem;
confitem item[8];

//////////GAME 




void setup()
{
  gb.begin();
  loadHighscore();  
  initGame();
}

void initGame(){
  gb.titleScreen(F("Descent into Hell"),logo);
  gb.pickRandomSeed(); //pick a different random seed each time for games to be different
  gb.battery.show = false; //hide the battery indicator
  for(byte i=0;i<MAX_SHOOT;i++){
       shoot[i].on=false; 
       shoot[i].vx=2;
       shoot[i].vy=2;
  }
  initDonjon();
  initPlayer();
  donjonlevel=1;
}

void initPlayer(){
  player.x=42;
  player.y=24;
  player.vx=2;
  player.vy=2;
  player.donjonroom=12;
  player.orientation=1;
  player.heal=5;
  player.damage=1;
  player.rate=1;
  player.score=0;
  player.invul=0;
}

void leveldown(){
  
  gb.pickRandomSeed();
  gb.sound.playOK(); 
  donjonlevel+=1;
  player.x=42;
  player.y=24;
  player.vx=2;
  player.vy=2;
  player.donjonroom=12;
  player.orientation=1;
  player.score+=100;
  for(byte i=0;i<MAX_SHOOT;i++){
      shoot[i].on=false; 
  }
  if(donjonlevel%2==1){
    for(byte i=0;i<NUM_MONSTER;i++){
      monstertype[NUM_MONSTER][0]+=1;
    }
  }
  for(byte i=0;i<25;i++){
     for(byte j=3;j<7;j++){
         Donjon[j][i]=0;
         Donjon[0][i]=i;
         Donjon[7][i]=0;
     }
  }
  Donjon[7][12]=1;
  ok=0;   
  finish=false;
  fin=false;
  initDonjon();
  gb.popup(F("Level Down"), 30);
}


void loop()
{ 
  if(gb.update()){
    if(playintro==true){
      gb.setFrameRate(10);
      Intro();
    }else{
      ok=0;
      for(byte i=0;i<MAX_MONSTER;i++){
          if(monster[i].on==true){
              if(gb.collideBitmapBitmap(monster[i].x,monster[i].y, Sprites_monster[monster[i].type], player.x, player.y,Sprites_player[player.orientation])){
                  if(player.invul<=0 and wait==0){
                    player.heal-=monster[i].damage;
                    player.invul=20;
                  }
              }
                ok=1;
          }
          if(item[i].on==true){
             ok=1;
          }
      }  
      if(gb.buttons.repeat(BTN_RIGHT,1)){ 
        player.x = player.x + player.vx;
        if(gb.buttons.repeat(BTN_A,1)){
        }else{
          player.orientation=1;
        }
      }
      
      if(gb.buttons.repeat(BTN_LEFT,1)){
        player.x = player.x - player.vx;
        if(gb.buttons.repeat(BTN_A,1)){
        }else{
          player.orientation=3;
        }
      }
      
      if(gb.buttons.repeat(BTN_DOWN,1)){
        player.y = player.y + player.vy;
        if(gb.buttons.repeat(BTN_A,1)){
        }else{
          player.orientation=2;
        }
      }
      
      if(gb.buttons.repeat(BTN_UP,1)){
        player.y = player.y - player.vy;
        if(gb.buttons.repeat(BTN_A,1)){
        }else{
          player.orientation=0;
        }
      }
      
      if(gb.buttons.repeat(BTN_A,1)){
        if(shootdelay<=0){
            shootdelay=15-(player.rate*10/50);
            initShoot();
          }
      }
      
      if(shootdelay>0){
         shootdelay-=1;
       }
      if(gb.buttons.pressed(BTN_C)){
        Map();
      }
      
      
      if(player.y<2 and player.x>37 and player.x<42){
          if(Donjon[3][player.donjonroom]==1 and ok==0){
             player.donjonroom-=5;
             for(byte i=0;i<MAX_MONSTER;i++){
               item[i].on=false;
             }
             if( Donjon[7][player.donjonroom]==0){
                initMonster(); 
             }
             Donjon[7][player.donjonroom]=1;
             player.y=35;
             for(byte i=0;i<MAX_SHOOT;i++){
                   shoot[i].on=false; 
              }
          }else if(Donjon[3][player.donjonroom]==2 and ok==0){
              leveldown();
          }
      }
      if(player.y>35 and player.x>37 and player.x<42){
         if(Donjon[5][player.donjonroom]==1 and ok==0){
             player.donjonroom+=5; 
             if( Donjon[7][player.donjonroom]==0){
                initMonster(); 
             }
             Donjon[7][player.donjonroom]=1;
             player.y=7;
             for(byte i=0;i<MAX_SHOOT;i++){
                  shoot[i].on=false; 
             }
         }else if(Donjon[5][player.donjonroom]==2 and ok==0){
              leveldown();
          }
      }
      if(player.x<7 and player.y<23 and player.y>19){
         if(Donjon[6][player.donjonroom]==1 and ok==0){
             player.donjonroom-=1;
             if( Donjon[7][player.donjonroom]==0){
                initMonster(); 
             } 
             Donjon[7][player.donjonroom]=1;
             player.x=72;
             for(byte i=0;i<MAX_SHOOT;i++){
                  shoot[i].on=false; 
             }
         }else if(Donjon[6][player.donjonroom]==2 and ok==0){
             leveldown();
          }
      }
      if(player.x>72 and player.y<23 and player.y>19){
         if(Donjon[4][player.donjonroom]==1 and ok==0){
             player.donjonroom+=1;
             if( Donjon[7][player.donjonroom]==0){
                initMonster(); 
             }
             Donjon[7][player.donjonroom]=1;
             player.x=7;
             for(byte i=0;i<MAX_SHOOT;i++){
                  shoot[i].on=false; 
             }
         }else if(Donjon[4][player.donjonroom]==2 and ok==0){
             leveldown();
          }
      }
      if(player.y < 2){
        player.y = 2;
      }
      if(player.y > 35){
        player.y = 35;
      }
      if(player.x < 7){
        player.x = 7;
      }
      if(player.x > 72){
        player.x = 72;
      }
      if(player.heal<=0){
       while(true){
        gb.display.cursorY = 10;
        gb.display.cursorX = 0;
        gb.display.fontSize = 2;
        gb.display.print("Game Over !");
        gb.display.cursorY = 32;
        gb.display.fontSize = 1;
        gb.display.cursorX = 16;
        gb.display.print("\27 Hight Score");
        if(gb.update()){
            if(gb.buttons.pressed(BTN_C)){
                break;
              }
        }
       }
       GameOver(); 
      }
      drawGame();
      drawItem();
      drawMonster();
      gb.display.drawBitmap(player.x,player.y,Sprites_player[player.orientation]);
      if(player.invul>0){
        player.invul-=1;
        gb.display.setColor(INVERT);
        if(player.invul%2==1){
          gb.display.drawBitmap(player.x,player.y,Sprites_player[player.orientation]);
          gb.display.setColor(BLACK); 
        }      
      }
      drawShoot();
      updateShoot();  
      updateItem();
      updateMonster();
    }
  }
}
void drawGame(){
  gb.display.drawBitmap(0,0,terrain);
  gb.display.setColor(INVERT);
  for(byte i=0;i<player.heal;i++){
    gb.display.drawBitmap(4+i*7,0,heal);
  }
  
  if(Donjon[3][player.donjonroom]==1){
     gb.display.drawBitmap(37,1,porte_haut);
     if(ok==1){
       gb.display.drawBitmap(39,4,barriere_horizontal);
     }
  }
  if(Donjon[4][player.donjonroom]==1){
     gb.display.drawBitmap(77,19,porte_droite);
     if(ok==1){
       gb.display.drawBitmap(77,21,barriere_vertical);
     }
  }
  if(Donjon[5][player.donjonroom]==1){
     gb.display.drawBitmap(37,41,porte_bas);
     if(ok==1){
       gb.display.drawBitmap(39,41,barriere_horizontal);
     }
  }
  if(Donjon[6][player.donjonroom]==1){
     gb.display.drawBitmap(1,19,porte_gauche);
     if(ok==1){
       gb.display.drawBitmap(4,21,barriere_vertical);
     }
  }
    if(Donjon[3][player.donjonroom]==2){
     gb.display.drawBitmap(36,0,descente_haut);
  }
  if(Donjon[4][player.donjonroom]==2){
     gb.display.drawBitmap(77,18,descente_droite);
  }
  if(Donjon[5][player.donjonroom]==2){
     gb.display.drawBitmap(36,41,descente_bas);
  }
  if(Donjon[6][player.donjonroom]==2){
     gb.display.drawBitmap(0,18,descente_gauche);
  }
  gb.display.setColor(BLACK);
}

void GameOver(){
  saveHighscore();
  gb.changeGame();
}
